## boards/shields/dactyl663/Kconfig.defconfig
```kconfig
if SHIELD_DACTYL663_LEFT

    # Name must be less than 16 characters long!
    config ZMK_KEYBOARD_NAME
        default "dactyl663"

    config ZMK_SPLIT_ROLE_CENTRAL
        default y

    config ZMK_SPLIT_BLE_CENTRAL_BATTERY_LEVEL_FETCHING
        default y

    config ZMK_SPLIT_BLE_CENTRAL_BATTERY_LEVEL_PROXY
        default y

endif

if SHIELD_DACTYL663_LEFT || SHIELD_DACTYL663_RIGHT

    config ZMK_SPLIT
        default y

    config ZMK_SLEEP
        default n 

    config ZMK_BATTERY_REPORTING
        default y

endif
```

## config/boards/shields/dactyl663/Kconfig.shield
```kconfig
# No whitespace after the comma or in your keyboard name!
config SHIELD_DACTYL663_LEFT
    def_bool $(shields_list_contains,dactyl663_left)

# No whitespace after the comma or in your keyboard name!
config SHIELD_DACTYL663_RIGHT
    def_bool $(shields_list_contains,dactyl663_right)
```
